## configs/mx6dlwise710a1_2G_defconfig
```kconfig
CONFIG_SPL=y
CONFIG_SYS_EXTRA_OPTIONS="IMX_CONFIG=board/freescale/mx6advantech/mx6dlwise710a1_4x_MT41K256M16TW-107_1410026783-01.cfg,SPL,MX6DL,SYS_USE_SPINOR"
CONFIG_ARM=y
CONFIG_ARCH_MX6=y
CONFIG_TARGET_MX6WISE710A1_2G=y
CONFIG_CMD_GPIO=y
```

## drivers/i2c/chips/Kconfig
```kconfig
#
# I2C algorithm drivers configuration
#

menu "I2C Chips"

config ADV_ECC508A
	bool "ADVANTECH I2C ECC508A support"
	help
	  This driver was support on WISE-710/TPC-71W only.
	  Enable Atmel ECC508A security chip.

endmenu
```

## drivers/net/phy/rtl83xx/Kconfig
```kconfig
menuconfig REALTEK_RTL83XX
	tristate "Realtek RTL83xx switch support"
	help
	  This driver adds support for Realtek RTL83xx managed switch chips. It provide
	  API functions through SMI with GPIO, MDC/MDIO and SPI interface to control
	  switch.

if REALTEK_RTL83XX

config REALTEK_RTL83XX_API
	tristate "Realtek RTL83xx API functions"
	depends on REALTEK_RTL83XX
	help
	  Select to enable support for registering switches configured through API function.

config REALTEK_RTL83XX_MDIO
	tristate "Using MDIO interface to configure RTL83xx switch PHYS."
	depends on REALTEK_RTL83XX

config REALTEK_RTL83XX_PHY_DRIVER
	tristate "Realtek RTL83XX switch phy driver"
	depends on REALTEK_RTL83XX
	help
	  Select Realtek RTL83xx switch PHY.

endif # REALTEK_RTL83XX
```
